## config/boards/shields/wyld_dm/Kconfig.shield
```kconfig
# config SHIELD_DACTYL_M6x6
#     bool

config SHIELD_DACTYL_M6x6_LEFT
    def_bool $(shields_list_contains,dactyl_m6x6_left)
#     select SHIELD_DACTYL_M6x6

config SHIELD_DACTYL_M6x6_RIGHT
    def_bool $(shields_list_contains,dactyl_m6x6_right)
#     select SHIELD_DACTYL_M6x6
```
